## main/Kconfig
```kconfig
menu "Raven LRS"

config RAVEN_TX_SUPPORT
    bool "Enable TX support"
    default "y"

config RAVEN_RX_SUPPORT
    bool "Enable RX support"
    default "y"

config RAVEN_FAKE_INPUT
    bool "Enable fake input support"
    default "n"

config RAVEN_USE_PWM_OUTPUTS
    depends on RAVEN_RX_SUPPORT
    bool "Enable PWM outputs"
    default "y"

config RAVEN_DIO5_CLK_OUTPUT
    bool "Enable LoRa CLK output on DIO 5"
    default "n"

config RAVEN_AIR_MODE_1
    bool "Enable support for Mode 1 (experimental)"
    default "n"

endmenu
```
